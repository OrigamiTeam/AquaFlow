#include <Arduino.h>

#define SI 15 // Serial data signal
#define SC 16 // Serial clock signal
#define RS 17 // Register select signal
#define RES 18 // Reset signal
#define CS 19  // Chip select signal

unsigned char numeros [] = {
0x07, 0x07, 0x07, 0x07, 0x07, 0x07, 0x07, 0x07, 0x07, 0x07, 0x07, 0x07, 0xFF, 0xFF, 0xFF, 0x00,
0x00, 0x00, 0x00, 0xFF, 0xFF, 0xFF, 0x00, 0x00, 0x00, 0x00, 0x00, 0x00, 0x00, 0x00, 0xFF, 0xFF,
0xFF, 0x00, 0x00, 0x00, 0x00, 0xFF, 0xFF, 0xFF, 0x07, 0x07, 0x07, 0x07, 0x07, 0x07, 0x07, 0x07,
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0x00, 0x01, 0x01, 0x00, 0x00, 0x00, 0x00, 0x00, 0x00, 0x00, 0x00, 0x01, 0x01, 0x00, 0x00, 0x00
};

unsigned char oito [] = {
0xF8, 0xF8, 0xF8, 0x38, 0x38, 0x38, 0x38, 0x38, 0x38, 0x38, 0x38, 0xF8, 0xF8, 0xF8, 0xFF, 0xFF,
0xFF, 0xC0, 0xC0, 0xC0, 0xC0, 0xC0, 0xC0, 0xC0, 0xC0, 0xFF, 0xFF, 0xFF, 0xFF, 0xFF, 0xFF, 0x01,
0x01, 0x01, 0x01, 0x01, 0x01, 0x01, 0x01, 0xFF, 0xFF, 0xFF, 0x0F, 0x0F, 0x0F, 0x0E, 0x0E, 0x0E,
0x0E, 0x0E, 0x0E, 0x0E, 0x0E, 0x0F, 0x0F, 0x0F, 
};

// Data Output Serial Interface
void dataWrite(unsigned char d) {
  digitalWrite(CS, LOW);
  digitalWrite(RS, HIGH);
  for (unsigned int n = 0; n < 8; n++) {
    if ((d & 0x80) == 0x80) {
      digitalWrite(SI, HIGH);
    }
    else {
      digitalWrite(SI, LOW);
    }
    while (0);
    d = (d << 1);
    digitalWrite(SC, LOW);
    while (0);
    digitalWrite(SC, HIGH);
    while (0);
    digitalWrite(SC, LOW);
  }
  digitalWrite(CS, HIGH);
}

// Command Output Serial Interface
void commWrite(unsigned char d) {
  digitalWrite(CS, LOW);
  digitalWrite(RS, LOW);
  for (unsigned int n = 0; n < 8; n++) {
    if ((d & 0x80) == 0x80) {
      digitalWrite(SI, HIGH);
    }
    else {
      digitalWrite(SI, LOW);
    }
    while (0);
    d = (d << 1);
    digitalWrite(SC, LOW);
    while (0);
    digitalWrite(SC, HIGH);
    while (0);
    digitalWrite(SC, LOW);
  }
  digitalWrite(CS, HIGH);
}

void WriteLCD(unsigned char *lcd_string, uint8_t inicio, uint8_t tamanho) {
  unsigned char page = 0xB0;
  commWrite(0xAE); // Display OFF
  commWrite(0x40); // Display start address + 0x40
  // 32pixel display / 8 pixels per page = 4 pages
  for (unsigned int i = 0; i < 4; i++) {
    commWrite(page); // send page address
    commWrite(0x10 + (inicio >> 4)); // column address upper 4 bits + 0x10
    commWrite(0x00 + (inicio & 0x0F)); // column address lower 4 bits + 0x00
    for (unsigned int j = 0; j < tamanho; j++) {
      dataWrite(*lcd_string); // send picture data
      lcd_string++;
    }
    page++; // after the columns, go to next page
  }
  commWrite(0xAF);
}

void ClearLCD(uint8_t inicio, uint8_t tamanho) {
  unsigned char page = 0xB0;
  commWrite(0xAE); // Display OFF
  commWrite(0x40); // Display start address + 0x40
  // 32pixel display / 8 pixels per page = 4 pages
  for (unsigned int i = 0; i < 4; i++) {
    commWrite(page); // send page address
    commWrite(0x10 + (inicio >> 4)); // column address upper 4 bits + 0x10
    commWrite(0x00 + (inicio & 0x0F)); // column address lower 4 bits + 0x00
    for (unsigned int j = 0; j < tamanho; j++) {
      dataWrite(0x00); // send data
    }
    page++; // after 128 columns, go to next page
  }
  commWrite(0xAF);
}

void initLCD() {
  commWrite(0xA0); // ADC select
  commWrite(0xAE); // Display OFF
  commWrite(0xC8); // COM direction scan
  commWrite(0xA2); // LCD bias set
  commWrite(0x2F); // Power Control set
  commWrite(0x21); // Resistor Ratio Set
  commWrite(0x81); // Electronic Volume Command (set contrast) Double Btye: 1 of 2
  commWrite(0x20); // Electronic Volume value (contrast value) Double Byte: 2 of 2
  commWrite(0xAF); // Display ON
}

void setup() {
  //DDRD = 0xFF;          // configure PORTD as output
  pinMode(RES, OUTPUT); // configure RES as output
  pinMode(CS, OUTPUT);  // configure CS as output
  pinMode(RS, OUTPUT);  // configure RS as output
  pinMode(SC, OUTPUT);  // configure SC as output
  pinMode(SI, OUTPUT);  // configure SI as output
  digitalWrite(RES, LOW);
  delay(100);
  digitalWrite(RES, HIGH);
  delay(100);
  initLCD();
  delay(100);

  ClearLCD(0, 128);
  delay(100);

  WriteLCD(numeros, 0, 128);
  delay(2000);
  ClearLCD(0, 128);
  delay(100);
}

void loop() {
  WriteLCD(oito, 0, 14);
  delay(1000);
  WriteLCD(oito, 18, 14);
  delay(1000);
  WriteLCD(oito, 36, 14);
  delay(1000);
  WriteLCD(oito, 54, 14);
  delay(1000);
  WriteLCD(oito, 72, 14);
  delay(1000);
  WriteLCD(oito, 90, 14);

  delay(2000);
  
  ClearLCD(0, 14);
  delay(1000);
  ClearLCD(18, 14);
  delay(1000);
  ClearLCD(36, 14);
  delay(1000);
  ClearLCD(54, 14);
  delay(1000);
  ClearLCD(72, 14);
  delay(1000);
  ClearLCD(90, 14);

  delay(2000);
}